/*
========================================================================================================================
**【文件描述】                                        【文件描述】                                        【文件描述】**
========================================================================================================================
**    文件名称: SysMode_VenderTestSpike.c 
**
**    功能描述: 系统模式 之  推杆拷机
**
**    公    司：蒙发利电子
**
**    项目名称：
**
**    平台信息：
**
**    作    者：Hzy
**
**    其他说明:	
**
**    修改记录:  --------------------------------------------------------------
**
========================================================================================================================
========================================================================================================================
*/

/*
========================================================================================================================
* 【文件包含】                                         【文件包含】                                          【文件包含】
========================================================================================================================
*/
#include "SysMode.h"


/*
========================================================================================================================
*【本地宏定义】                                       【本地宏定义】                                       【本地宏定义】
========================================================================================================================
*/


/*
========================================================================================================================
*【本地数据类型定义】                              【本地数据类型定义】                              【本地数据类型定义】
========================================================================================================================
*/


/*
========================================================================================================================
*【变量定义 & 各种声明】                          【变量定义 & 各种声明】                          【变量定义 & 各种声明】    
========================================================================================================================
*/


/*
========================================================================================================================
*【函数定义】                                          【函数定义】                                          【函数定义】
========================================================================================================================
*/
/*
************************************************************************************************************************
* 函数名称 : SysMode_TestSpike_Timer                                                                                                         
* 功能描述 : 拷机推杆 定时器 处理                                                                                     
* 输入参数 : ExePeriod -- 执行周期                                                                    
* 返回参数 : 无                                                           
* 补充说明 : 无                                                                                                         
************************************************************************************************************************
*/
void SysMode_TestSpike_Timer(Ticker_t ExePeriod)
{ 
  if(pMChair->SysModeCur != SYS_MODE_TESTSPIKE)
  {
    return;
  }

  pMChair->CommonTimeSec++;
  if(pMChair->CommonTimeSec <= 60)                /*0~60s，倒背升腿*/
  {
    Spike_SetAngle(PBACK_MAX, PFEET_MAX, PZERO_MAX);  
  }
  else if(pMChair->CommonTimeSec <= 120)           /*61~120S，升背降腿*/
  {
    Spike_SetAngle(PBACK_MIN, PFEET_MIN, PZERO_MIN);  
  }
  else                                            /*时间清零，循环*/
  {
    pMChair->CommonTimeSec = 0;
  }
}

/*
************************************************************************************************************************
* 函数名称 : SysMode_TestSpike_Init                                                                                                         
* 功能描述 : 系统模式 之 拷机推杆 初始化                                                                                     
* 输入参数 : 无                                                                               
* 返回参数 : 无                                                           
* 补充说明 : 无                                                                                                         
************************************************************************************************************************
*/
void SysMode_TestSpike_Init(void)
{

}


/*
************************************************************************************************************************
* 函数名称 : SysMode_TestSpike_Handle                                                                                                         
* 功能描述 : 系统模式 之 拷机推杆 处理                                                                                     
* 输入参数 : 无                                                                              
* 返回参数 : 无                                                               
* 补充说明 : 无                                                                                                         
************************************************************************************************************************
*/
void SysMode_TestSpike_Handle(void)
{
  /*发生模式切换操作-----------------------------------------------------*/
  if(pMChair->SysModeHis != pMChair->SysModeCur)      
  {
    pMChair->SysModeHis = pMChair->SysModeCur; 
  }

  /*根据各个模式的不同，对键值处理相关变量赋值---------------------------*/
  SysMode_DefaultKeyValHandle();
}
