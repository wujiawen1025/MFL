/*
========================================================================================================================
**【文件描述】                                        【文件描述】                                        【文件描述】**
========================================================================================================================
**    文件名称: bsp_systicker.c 
**
**    功能描述: 系统滴答时钟定时器
**
**    公    司：蒙发利电子
**
**    项目名称：
**
**    平台信息：
**
**    作    者：LZH
**
**    其他说明:                                                                                                        
**
**    修改记录:  
**
========================================================================================================================
========================================================================================================================
*/
/*
========================================================================================================================
* 【文件包含】                                         【文件包含】                                          【文件包含】
========================================================================================================================
*/
#include "bsp_systicker.h"


/*
========================================================================================================================
*【本地宏定义】                                       【本地宏定义】                                       【本地宏定义】
========================================================================================================================
*/
#define SYSTICK_CLK_HZ CLOCK_GetFreq(kCLOCK_CoreSysClk)


/*
========================================================================================================================
*【本地数据类型定义】                              【本地数据类型定义】                              【本地数据类型定义】
========================================================================================================================
*/
/*
************************************************************************************************************************
* 类型定义 :  系统滴答时钟 相关操作数据结构                                                                                                     
************************************************************************************************************************
*/
typedef struct
{
  Ticker_t    TickCount;       /*滴答时钟计数*/

}SysTicker_t;


/*
========================================================================================================================
*【变量定义 & 各种声明】                          【变量定义 & 各种声明】                          【变量定义 & 各种声明】    
========================================================================================================================
*/
static SysTicker_t SysTicker;


/*
========================================================================================================================
*【函数定义】                                          【函数定义】                                          【函数定义】
========================================================================================================================
*/
/*
************************************************************************************************************************
* 函数名称 : BSP_GPIO_Init                                                                                                        
* 功能描述 : 系统定时器初始化。                                                                                                        
* 输入参数 : 无                                                                                                         
* 返回参数 : 无                                                                                                         
* 补充说明 : 无                                                                                                         
************************************************************************************************************************
*/
void BSP_SysTicker_Init(void)
{
  SysTick_Config(SystemCoreClock / SYS_TICKER_PER_SEC);   /* 默认使用内核时钟 core clock*/

  SysTicker.TickCount = 0;     
}


/*
************************************************************************************************************************
* 函数名称 : BSP_SysTicker_GetCurTick                                                                                                        
* 功能描述 : 获取当前系统的tick计数。                                                                                                        
* 输入参数 : 无                                                                                                         
* 返回参数 : 当前系统的tick计数
* 补充说明 : 无                                                                                                         
************************************************************************************************************************
*/
Ticker_t BSP_SysTicker_GetCurTick(void)
{
  return SysTicker.TickCount;
}


/*
************************************************************************************************************************
* 函数名称 : BSP_SysTicker_GetCurUs                                                                                                        
* 功能描述 : 获取当前系统定时器的us数。                                                                                                        
* 输入参数 : 无                                                                                                         
* 返回参数 : 当前系统定时器的us数
* 补充说明 : ★ 这里直接返回0。即可不必返回如此精确的微妙值。微秒值是用来参与计算转速时使用的。★
*            ★ 分析(目前所用马达转速都没那么高，如ECP388A的机芯才2500转)：                    ★
*            ★   · 按 3000转/分 的马达来算，则1转所消耗时间 = 60000ms / 3000转 = 20ms         ★
*            ★   · 按 6000转/分 的马达来算，则1转所消耗时间 = 60000ms / 6000转 = 10ms         ★
*            ★ 由上，可知直接使用ms为计算单位，误差已经很小了，可忽略不计。                   ★
*            ★ 当然，日后如果使用转速非常高的马达，则必须返回精确的微妙数值。                 ★
************************************************************************************************************************
*/
uint16_t BSP_SysTicker_GetCurUs(void)
{
  return 0;
}


/*
************************************************************************************************************************
* 函数名称 : BSP_SysTicker_CalLag                                                                                                        
* 功能描述 : 计算时间差。                                                                                                        
* 输入参数 : tick -- 之前的tick计数      
* 返回参数 : tick计数 与 系统当前tick 计数 的差值。  
* 补充说明 : 无                                                                                                         
************************************************************************************************************************
*/
Ticker_t BSP_SysTicker_CalLag(Ticker_t tick)
{
  if(SysTicker.TickCount >= tick)
  {
    return (SysTicker.TickCount - tick);
  }
  else /*系统时间计数值已经溢出*/
  {
    return (SysTicker.TickCount + (TICKER_MAX-tick) + 1);
  }
}


/*
************************************************************************************************************************
* 函数名称 : SysTick_Handler                                                                                                        
* 功能描述 : 系统定时器中断函数                                                                                                        
* 输入参数 : 无                                                                                                         
* 返回参数 : 无                                                                                                         
* 补充说明 : 无                                                                                                         
************************************************************************************************************************
*/
extern uint8_t Rx_Time;
extern uint8_t RxHandleFlag1;
extern uint8_t RxHandleFlag;
void SysTick_Handler()
{
//  static uint8_t i=0;

  SysTicker.TickCount++;
  	Rx_Time ++;
		 if(Rx_Time ==15)
		 {
			 Rx_Time  = 0;
			 if(RxHandleFlag1 ==1)
			 {
			   RxHandleFlag = 1;
				 RxHandleFlag1 = 0;
			 }
		 }
  // 外接示波器，测试时间周期用 
//  if(i)
//  {
//    GPIO_WriteBit(GPIOA, GPIO_Pin_6, 1);
//    i=0;
//  }
//  else
//  {
//    GPIO_WriteBit(GPIOA, GPIO_Pin_6, 0);
//    i=1;
//  }  
}

